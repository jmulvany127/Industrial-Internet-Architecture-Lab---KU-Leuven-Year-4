## CMakeLists.txt
```
cmake_minimum_required(VERSION 3.20.0)
find_package(Zephyr REQUIRED HINTS $ENV{ZEPHYR_BASE})

project(freebot_demo)

include_directories(lib/freebot/inc)
target_sources(app PRIVATE src/main.c src/bt_lbs.c src/my_nus_stuff.c lib/freebot/src/fb_motor.c lib/freebot/src/fb_io.c lib/freebot/src/fb_pwr.c)
```

## Kconfig
```
#
# Copyright (c) 2018 Nordic Semiconductor
#
# SPDX-License-Identifier: LicenseRef-Nordic-5-Clause
#

source "Kconfig.zephyr"

menu "Nordic UART BLE GATT service sample"

config BT_NUS_THREAD_STACK_SIZE
	int "Thread stack size"
	default 1024
	help
	  Stack size used of the ble_write_thread thread

config BT_NUS_UART_BUFFER_SIZE
	int "UART payload buffer element size"
	default 40
	help
	  Size of the payload buffer in each RX and TX FIFO element

config BT_NUS_SECURITY_ENABLED
	bool "Enable security"
	default y
	select BT_SMP
	help
	  "Enable BLE security for the UART service"

config BT_NUS_UART_RX_WAIT_TIME
	int "Timeout for UART RX complete event"
	default 50
	help
	  Wait for RX complete event time in milliseconds

config BT_NUS_UART_ASYNC_ADAPTER
	bool "Enable UART async adapter"
	select SERIAL_SUPPORT_ASYNC
	help
	  Enables asynchronous adapter for UART drives that supports only
	  IRQ interface.

endmenu
```

## prj.conf
```kconfig
CONFIG_CONSOLE=y
CONFIG_CONSOLE_SUBSYS=y
CONFIG_CONSOLE_HANDLER=y
CONFIG_CONSOLE_GETCHAR=y

# Enable logging
CONFIG_LOG=y
CONFIG_USE_SEGGER_RTT=y
CONFIG_LOG_BACKEND_RTT=y
CONFIG_LOG_BACKEND_UART=n


# Enable ADC for voltage measurements
CONFIG_ADC=y

# Enable thread debugging
CONFIG_DEBUG_THREAD_INFO=y

# Autogenerated
CONFIG_COMMON_LIBC_MALLOC_ARENA_SIZE=-1
CONFIG_THREAD_LOCAL_STORAGE=y
CONFIG_COMPILER_FREESTANDING=n
CONFIG_FORTIFY_SOURCE_COMPILE_TIME=y

#BT
CONFIG_BT=y
CONFIG_BT_PERIPHERAL=y
CONFIG_BT_DEVICE_NAME="Nordic_LBS_13_V2"
CONFIG_BT_MAX_CONN=1
CONFIG_BT_MAX_PAIRED=1
CONFIG_BT_RX_STACK_SIZE=2048
# Enable the NUS service
# STEP 1 - Enable the Kconfig symbol of the NUS service
CONFIG_BT_NUS=y
CONFIG_BT_NUS_AUTHEN=n
CONFIG_BT_NUS_SECURITY_ENABLED=y
CONFIG_BT_SMP=y
# disable bonding
CONFIG_BT_SETTINGS=n
CONFIG_FLASH=n
CONFIG_FLASH_PAGE_LAYOUT=n
CONFIG_FLASH_MAP=n
CONFIG_NVS=n
CONFIG_SETTINGS=n

# Enable the LBS service
# CONFIG_BT_LBS=y
# CONFIG_BT_LBS_POLL_BUTTON=y
CONFIG_DK_LIBRARY=y

# Increase stack size for the main thread and System Workqueue
CONFIG_SYSTEM_WORKQUEUE_STACK_SIZE=2048
CONFIG_HEAP_MEM_POOL_SIZE=2048
CONFIG_MAIN_STACK_SIZE=4096


CONFIG_UART_ASYNC_API=y
CONFIG_NRFX_UARTE0=y

# CONFIG_ASSERT=y
```

## app.overlay
```dts
/ {
    chosen {
        zephyr,entropy = &cryptocell;
        nordic,nus-uart = &uart0;
    };
};

&cryptocell {
    status = "okay";
};
/*
&uart1 {
    status = "okay";
};
 */
```

## src/main.c
```c
/**
 * @file main.c
 * @author Lowie Deferme <lowie.deferme@kuleuven.be>
 * @brief FreeBot zephyr example
 * @version 0.1
 * @date 2024-03-26
 *
 * @copyright Copyright (c) 2024
 *
 */

#include <zephyr/types.h>
#include <zephyr/kernel.h>
#include <zephyr/logging/log.h>

#include <zephyr/sys/printk.h>
#include <zephyr/sys/byteorder.h>
#include <soc.h>

#include <zephyr/bluetooth/bluetooth.h>
#include <zephyr/bluetooth/hci.h>
#include <zephyr/bluetooth/conn.h>
#include <zephyr/bluetooth/uuid.h>
#include <zephyr/bluetooth/gatt.h>

// #include <bluetooth/services/lbs.h>
#include <bluetooth/services/nus.h>

#include <zephyr/settings/settings.h>

#include <stdio.h>

#include "my_nus_stuff.h"

extern struct k_fifo fifo_tx_data;
extern struct k_fifo fifo_rx_data;
extern struct k_sem ble_init_ok;
// #include "bt_lbs.h"

#define USER_BUTTON DK_BTN1_MSK
#define RUN_STATUS_LED DK_LED1
/* STEP 3.1 - Define an LED to show the connection status */
#define CONNECTION_STATUS_LED DK_LED2
#define RUN_LED_BLINK_INTERVAL 1000

LOG_MODULE_REGISTER(freebot, LOG_LEVEL_DBG);

#include "freebot.h"
#define FB_DEMO_DELAY K_MSEC(500)

static fb_motor_angle_t motor_angles;
static fb_motor_speed_t motor_speeds;

void pwr_measure_demo(void)
{
    int v_cap = fb_v_measure();
    LOG_DBG("Vcap = %dmV", v_cap);
    k_sleep(FB_DEMO_DELAY);
}

void motor_drive_demo(void)
{
    fb_straight_forw();
    LOG_DBG("Robot going forward");
    k_sleep(FB_DEMO_DELAY);

    fb_straight_back();
    LOG_DBG("Robot going backward");
    k_sleep(FB_DEMO_DELAY);

    fb_side_right();
    LOG_DBG("Robot going right");
    k_sleep(FB_DEMO_DELAY);

    fb_side_left();
    LOG_DBG("Robot going left");
    k_sleep(FB_DEMO_DELAY);

    fb_side_d45();
    LOG_DBG("Robot going 45°");
    k_sleep(FB_DEMO_DELAY);

    fb_side_d135();
    LOG_DBG("Robot going 135°");
    k_sleep(FB_DEMO_DELAY);

    fb_side_d225();
    LOG_DBG("Robot going 225°");
    k_sleep(FB_DEMO_DELAY);

    fb_side_d315();
    LOG_DBG("Robot going 315°");
    k_sleep(FB_DEMO_DELAY);

    fb_rotate_cw();
    LOG_DBG("Robot rotating clockwise");
    k_sleep(FB_DEMO_DELAY);

    fb_rotate_ccw();
    LOG_DBG("Robot rotating counterclockwise");
    k_sleep(FB_DEMO_DELAY);

    fb_stop();
    LOG_DBG("Robot stopped");
}

// motor_angles.front_left, //Z
// motor_angles.front_right, //Y
// motor_angles.back_left, //X
// motor_angles.back_right); //W
// motor_speeds.front_left, //V
// motor_speeds.front_right, //U
// motor_speeds.back_left, //T
// motor_speeds.back_right); //S
// fb_v_measure_select(V_CAP); //R
// <A|val,B|val,C|val>

void motor_measure_demo(void)
{
    fb_get_motor_angle(&motor_angles);
    LOG_DBG("{%d°, %d°, %d°, %d°}",
            motor_angles.front_left,  // Z
            motor_angles.front_right, // Y
            motor_angles.back_left,   // X
            motor_angles.back_right); // W

    fb_rotate_cw();
    k_sleep(K_MSEC(200));
    fb_get_motor_speed(&motor_speeds);
    LOG_DBG("{%d rpm, %d rpm, %d rpm, %d rpm}",
            motor_speeds.front_left,  // V
            motor_speeds.front_right, // U
            motor_speeds.back_left,   // T
            motor_speeds.back_right); // S
    fb_stop();
    for (int i = 0; i < 4; i++)
    {
        k_sleep(K_MSEC(100));
        fb_get_motor_speed(&motor_speeds);
        LOG_DBG("{%d rpm, %d rpm, %d rpm, %d rpm}",
                motor_speeds.front_left,
                motor_speeds.front_right,
                motor_speeds.back_left,
                motor_speeds.back_right);
    }

    fb_get_motor_angle(&motor_angles);
    LOG_DBG("{%d°, %d°, %d°, %d°}",
            motor_angles.front_left,
            motor_angles.front_right,
            motor_angles.back_left,
            motor_angles.back_right);
}

// #define DEVICE_NAME CONFIG_BT_DEVICE_NAME
// #define DEVICE_NAME_LEN (sizeof(DEVICE_NAME) - 1)

// struct bt_conn *my_conn = NULL;

// static const struct bt_data ad[] = {
// 	BT_DATA_BYTES(BT_DATA_FLAGS, (BT_LE_AD_GENERAL | BT_LE_AD_NO_BREDR)),
// 	BT_DATA(BT_DATA_NAME_COMPLETE, DEVICE_NAME, DEVICE_NAME_LEN),
// };

// static const struct bt_data sd[] = {
// 	BT_DATA_BYTES(BT_DATA_UUID128_ALL, BT_UUID_LBS_VAL),
// };

// // /* STEP 5.1 - Create the advertising parameter for connectable advertising */
// // static struct bt_le_adv_param *adv_param = BT_LE_ADV_PARAM(
// // 	(BT_LE_ADV_OPT_CONNECTABLE |
// // 	 BT_LE_ADV_OPT_USE_IDENTITY), /* Connectable advertising and use identity address */
// // 	800, /* Min Advertising Interval 500ms (800*0.625ms) */
// // 	801, /* Max Advertising Interval 500.625ms (801*0.625ms) */
// // 	NULL); /* Set to NULL for undirected advertising */
// static struct bt_le_adv_param *adv_param = BT_LE_ADV_PARAM(
// 	(BT_LE_ADV_OPT_CONNECTABLE |
// 	 BT_LE_ADV_OPT_USE_IDENTITY), /* Connectable advertising and use identity address */
// 	BT_GAP_ADV_FAST_INT_MIN_1, /* 0x30 units, 48 units, 30ms */
// 	BT_GAP_ADV_FAST_INT_MAX_1, /* 0x60 units, 96 units, 60ms */
// 	NULL); /* Set to NULL for undirected advertising */

// //nof connected ble devices
// static bool bleConnected = false;

// /* STEP 2.2 - Implement the callback functions */
// void on_connected(struct bt_conn *conn, uint8_t err)
// {
// 	if (err) {
// 		LOG_ERR("Connection error %d", err);
// 		return;
// 	}
// 	LOG_INF("Connected");
// 	my_conn = bt_conn_ref(conn);
//     bleConnected = true;

// 	/* STEP 3.2  Turn the connection status LED on */
//     // fb_toggle_led(D15);

// }

// void on_disconnected(struct bt_conn *conn, uint8_t reason)
// {
// 	LOG_INF("Disconnected. Reason %d", reason);
// 	bt_conn_unref(my_conn);
//     bleConnected = false;

// 	/* STEP 3.3  Turn the connection status LED off */
//     // fb_toggle_led(D15);
// }

// /* STEP 2.1 - Declare the connection_callback structure */
// struct bt_conn_cb connection_callbacks = {
// 	.connected = on_connected,
// 	.disconnected = on_disconnected,
// };

// /* STEP 8.2 - Define the application callback function for controlling the LED */
// static void app_led_cb(bool led_state)
// {
//     if (led_state) {
//         fb_set_led(D16);
//         fb_rotate_cw();
//         LOG_DBG("Robot going forward");
//     } else {
//         fb_clear_led(D16);
//         fb_stop();
//         LOG_DBG("Robot stopped");
//     }
//     k_sleep(FB_DEMO_DELAY);
// }

// /* STEP 9.2 - Define the application callback function for reading the state of the button */
// static int app_button_cb(void)
// {
//     fb_get_motor_angle(&motor_angles);
//     // return motor_angles.front_right;
//     return 0xF5;
// }

// /* STEP 10 - Declare a varaible app_callbacks of type my_lbs_cb and initiate its members to the applications call back functions we developed in steps 8.2 and 9.2. */
// static struct my_lbs_cb app_callbacks = {
//     .led_cb = app_led_cb,
//     .button_cb = app_button_cb,
// };

// // -----------------
// //  COMMAND PARSING
// // -----------------
// // void processCommand(const unsigned char* buffer, const size_t length) {
// //     int command = 0;

// //     return;
// // }

extern int bleConnected;

int main(void)
{
    LOG_DBG("Starting Robot");
    fb_init();
    fb_v_measure_select(V_CAP); // R

    int err;
    err = my_nus_main();

    // /* STEP 2.3 - Register our custom callbacks */
    // bt_conn_cb_register(&connection_callbacks);

    // err = bt_enable(NULL);
    // if (err) {
    // 	printk("Bluetooth init failed (err %d)\n", err);
    // 	return -1;
    // }
    // LOG_DBG("Bluetooth initialized\n");

    // /* STEP 11 - Pass your application callback functions stored in app_callbacks to the MY LBS service */
    // err = my_lbs_init(&app_callbacks);
    // if (err) {
    // 	printk("Failed to init LBS (err:%d)\n", err);
    // 	return -1;
    // }

    // // advertise
    // err = bt_le_adv_start(adv_param, ad, ARRAY_SIZE(ad), sd, ARRAY_SIZE(sd));
    // if (err) {
    // 	printk("Advertising failed to start (err %d)\n", err);
    // 	return -1;
    // }

    for (;;)
    {
        // Flash both leds in out of sync to indicate ready
        fb_set_led(D15);
        fb_clear_led(D16);
        for (;;)
        {
            k_sleep(K_MSEC(2000));
            fb_toggle_led(D15);
            fb_toggle_led(D16);

            // if (bleConnected)
            // {
            //     LOG_DBG("ble connected");

            //     // err = bt_lbs_send_button_state(true);
            //     if (err) {
            //         LOG_ERR("Couldn't send notification. err: %d", err);
            //     }
            //     k_sleep(K_MSEC(300));
            //     fb_set_led(D15);
            //     fb_set_led(D16);
            //     while (1) {};
            // }
        }

        // Turn both leds off during operation
        fb_clear_led(D15);
        fb_clear_led(D16);

        // pwr_measure_demo();
        // motor_measure_demo();
        // motor_drive_demo();
    }
    return 0;
}

// void move_thread(void)
// {
// 	for (int i = 0;;i++) {
//         // motor_drive_demo();
//         fb_straight_forw();
//         k_sleep(K_MSEC(4000));
//         fb_straight_back();
//         k_sleep(K_MSEC(4000));
//         fb_stop();
//         k_sleep(K_MSEC(4000));

// 	}
// }
// /* STEP 9.2 - Create a dedicated thread for sending the data over Bluetooth LE. */
// K_THREAD_DEFINE(move_thread_id, STACKSIZE, move_thread, NULL, NULL, NULL, PRIORITY, 0, 0);
```

## src/bt_lbs.c
```c
/*
 * Copyright (c) 2018 Nordic Semiconductor ASA
 *
 * SPDX-License-Identifier: LicenseRef-Nordic-5-Clause
 */

/** @file
 *  @brief LED Button Service (LBS) sample
 */

#include <zephyr/types.h>
#include <stddef.h>
#include <string.h>
#include <errno.h>
#include <zephyr/sys/printk.h>
#include <zephyr/sys/byteorder.h>
#include <zephyr/kernel.h>

#include <zephyr/bluetooth/bluetooth.h>
#include <zephyr/bluetooth/hci.h>
#include <zephyr/bluetooth/conn.h>
#include <zephyr/bluetooth/uuid.h>
#include <zephyr/bluetooth/gatt.h>

#include "bt_lbs.h"

#include <zephyr/logging/log.h>

LOG_MODULE_DECLARE(bt_lbs);

static int button_state;
static struct my_lbs_cb lbs_cb;

/* STEP 6 - Implement the write callback function of the LED characteristic */
static ssize_t write_led(struct bt_conn *conn, const struct bt_gatt_attr *attr, const void *buf,
                         uint16_t len, uint16_t offset, uint8_t flags)
{
    LOG_DBG("Attribute write, handle: %u, conn: %p", attr->handle, (void *)conn);

    if (len != 1U)
    {
        LOG_DBG("Write led: Incorrect data length");
        return BT_GATT_ERR(BT_ATT_ERR_INVALID_ATTRIBUTE_LEN);
    }

    if (offset != 0)
    {
        LOG_DBG("Write led: Incorrect data offset");
        return BT_GATT_ERR(BT_ATT_ERR_INVALID_OFFSET);
    }

    if (lbs_cb.led_cb)
    {
        // Read the received value
        uint8_t val = *((uint8_t *)buf);

        if (val == 0x00 || val == 0x01)
        {
            // Call the application callback function to update the LED state
            lbs_cb.led_cb(val ? true : false);
        }
        else
        {
            LOG_DBG("Write led: Incorrect value");
            return BT_GATT_ERR(BT_ATT_ERR_VALUE_NOT_ALLOWED);
        }
    }

    return len;
}

/* STEP 5 - Implement the read callback function of the Button characteristic */
static ssize_t read_button(struct bt_conn *conn, const struct bt_gatt_attr *attr, void *buf,
                           uint16_t len, uint16_t offset)
{
    // get a pointer to button_state which is passed in the BT_GATT_CHARACTERISTIC() and stored in attr->user_data
    const char *value = attr->user_data;

    LOG_DBG("Attribute read, handle: %u, conn: %p", attr->handle, (void *)conn);

    if (lbs_cb.button_cb)
    {
        // Call the application callback function to update the get the current value of the button
        button_state = lbs_cb.button_cb();
        return bt_gatt_attr_read(conn, attr, buf, len, offset, value, sizeof(*value));
    }

    return 0;
}

/* LED Button Service Declaration */
/* STEP 2 - Create and add the MY LBS service to the Bluetooth LE stack */
BT_GATT_SERVICE_DEFINE(my_lbs_svc, BT_GATT_PRIMARY_SERVICE(BT_UUID_LBS),
                       /* STEP 3 - Create and add the Button characteristic */
                       BT_GATT_CHARACTERISTIC(BT_UUID_LBS_BUTTON, BT_GATT_CHRC_READ,
                                              BT_GATT_PERM_READ, read_button, NULL, &button_state),
                       /* STEP 4 - Create and add the LED characteristic. */
                       BT_GATT_CHARACTERISTIC(BT_UUID_LBS_LED, BT_GATT_CHRC_WRITE,
                                              BT_GATT_PERM_WRITE_ENCRYPT, NULL, write_led, NULL),

);
/* A function to register application callbacks for the LED and Button characteristics  */
int my_lbs_init(struct my_lbs_cb *callbacks)
{
    if (callbacks)
    {
        lbs_cb.led_cb = callbacks->led_cb;
        lbs_cb.button_cb = callbacks->button_cb;
    }

    return 0;
}
```

## src/bt_lbs.h
```c
/*
 * Copyright (c) 2018 Nordic Semiconductor ASA
 *
 * SPDX-License-Identifier: LicenseRef-Nordic-5-Clause
 */

#ifndef MY_LBS_H_
#define MY_LBS_H_

/**@file
 * @defgroup bt_lbs LED Button Service API
 * @{
 * @brief API for the LED Button Service (LBS).
 */

#ifdef __cplusplus
extern "C" {
#endif

#include <zephyr/types.h>

/* STEP 1 - Define the 128 bit UUIDs for the GATT service and its characteristics in */
/** @brief LBS Service UUID. */
#define BT_UUID_LBS_VAL BT_UUID_128_ENCODE(0x00001523, 0x1212, 0xefde, 0x1523, 0x785feabcd123)

/** @brief Button Characteristic UUID. */
#define BT_UUID_LBS_BUTTON_VAL                                                                     \
	BT_UUID_128_ENCODE(0x00001526, 0x1212, 0xefde, 0x1523, 0x785feabcd123)

/** @brief LED Characteristic UUID. */
#define BT_UUID_LBS_LED_VAL BT_UUID_128_ENCODE(0x00001525, 0x1212, 0xefde, 0x1523, 0x785feabcd123)

#define BT_UUID_LBS BT_UUID_DECLARE_128(BT_UUID_LBS_VAL)
#define BT_UUID_LBS_BUTTON BT_UUID_DECLARE_128(BT_UUID_LBS_BUTTON_VAL)
#define BT_UUID_LBS_LED BT_UUID_DECLARE_128(BT_UUID_LBS_LED_VAL)

/** @brief Callback type for when an LED state change is received. */
typedef void (*led_cb_t)(const bool led_state);

/** @brief Callback type for when the button state is pulled. */
typedef int (*internal_button_cb_t)(void);

/** @brief Callback struct used by the LBS Service. */
struct my_lbs_cb {
	/** LED state change callback. */
	led_cb_t led_cb;
	/** Button read callback. */
	internal_button_cb_t button_cb;
};

/** @brief Initialize the LBS Service.
 *
 * This function registers application callback functions with the My LBS
 * Service
 *
 * @param[in] callbacks Struct containing pointers to callback functions
 *			used by the service. This pointer can be NULL
 *			if no callback functions are defined.
 *
 *
 * @retval 0 If the operation was successful.
 *           Otherwise, a (negative) error code is returned.
 */
int my_lbs_init(struct my_lbs_cb *callbacks);

#ifdef __cplusplus
}
#endif

/**
 * @}
 */

#endif /* MY_LBS_H_ */
```

## src/my_nus_stuff.c
```c
#include "uart_async_adapter.h"

#include <zephyr/logging/log.h>

#include <zephyr/types.h>
#include <zephyr/kernel.h>
#include <zephyr/drivers/uart.h>
#include <zephyr/usb/usb_device.h>

#include <zephyr/device.h>
#include <zephyr/devicetree.h>
#include <soc.h>

#include <zephyr/bluetooth/bluetooth.h>
#include <zephyr/bluetooth/uuid.h>
#include <zephyr/bluetooth/gatt.h>
#include <zephyr/bluetooth/hci.h>

#include <bluetooth/services/nus.h>

#include <stdio.h>

#include <zephyr/settings/settings.h>
#include "fb_io.h"
#include "fb_motor.h"
#include "fb_pwr.h"

#include "my_nus_stuff.h"

LOG_MODULE_REGISTER(my_nus, LOG_LEVEL_INF);

// #define CONFIG_BT_NUS_UART_BUFFER_SIZE 40
// #define CONFIG_BT_NUS_UART_RX_WAIT_TIME 50

#define DEVICE_NAME CONFIG_BT_DEVICE_NAME
#define DEVICE_NAME_LEN (sizeof(DEVICE_NAME) - 1)

#define UART_WAIT_FOR_BUF_DELAY K_MSEC(50)
#define UART_WAIT_FOR_RX CONFIG_BT_NUS_UART_RX_WAIT_TIME

extern struct k_sem ble_init_ok;
static K_SEM_DEFINE(sem_reading, 0, 1); // semaphore for the cyclical readings buffer

extern struct k_fifo fifo_tx_data;
extern struct k_fifo fifo_rx_data;

static const struct bt_data ad[] = {
    BT_DATA_BYTES(BT_DATA_FLAGS, (BT_LE_AD_GENERAL | BT_LE_AD_NO_BREDR)),
    BT_DATA(BT_DATA_NAME_COMPLETE, DEVICE_NAME, DEVICE_NAME_LEN),
};

static const struct bt_data sd[] = {
    BT_DATA_BYTES(BT_DATA_UUID128_ALL, BT_UUID_NUS_VAL),
};

static void connected(struct bt_conn *conn, uint8_t err)
{
    if (err)
    {
        LOG_ERR("Connection failed (err %u)", err);
        return;
    }

    // bt_addr_le_to_str(bt_conn_get_dst(conn), addr, sizeof(addr));
    LOG_INF("Connected");
}

static void disconnected(struct bt_conn *conn, uint8_t reason)
{
    LOG_INF("Disconnected:(reason %u)", reason);
}

static void on_security_changed(struct bt_conn *conn, bt_security_t level, enum bt_security_err err)
{
    char addr[BT_ADDR_LE_STR_LEN];

    bt_addr_le_to_str(bt_conn_get_dst(conn), addr, sizeof(addr));

    if (!err)
    {
        LOG_INF("Security changed: %s level %u", addr, level);
    }
    else
    {
        LOG_WRN("Security failed: %s level %u err %d", addr, level, err);
    }
}

struct bt_conn_cb connection_callbacks = {
    .connected = connected,
    .disconnected = disconnected,
    .security_changed = on_security_changed,
};
static void bt_receive_cb(struct bt_conn *conn, const uint8_t *const data, uint16_t len)
{
    char addr[BT_ADDR_LE_STR_LEN] = {0};

    bt_addr_le_to_str(bt_conn_get_dst(conn), addr, ARRAY_SIZE(addr));

    LOG_INF("Received data from: %s", addr);

    for (uint16_t pos = 0; pos != len;)
    {
        struct packet_data_t *tx = k_malloc(sizeof(*tx));

        if (!tx)
        {
            LOG_WRN("Not able to allocate UART send data buffer");
            return;
        }

        /* Keep the last byte of TX buffer for potential LF char. */
        size_t tx_data_size = sizeof(tx->data) - 1;

        if ((len - pos) > tx_data_size)
        {
            tx->len = tx_data_size;
        }
        else
        {
            tx->len = (len - pos);
        }

        memcpy(tx->data, &data[pos], tx->len);

        pos += tx->len;

        /* Append the LF character when the CR character triggered
         * transmission from the peer.
         */
        if ((pos == len) && (data[len - 1] == '\r'))
        {
            tx->data[tx->len] = '\n';
            tx->len++;
        }

        // process the received command
        k_fifo_put(&fifo_rx_data, tx);
    }
}
static struct bt_nus_cb nus_cb = {
    .received = bt_receive_cb,
};

void error(void)
{
    // SET LEDS TO SHOW there is an ERROR
    fb_set_led(D15);
    fb_set_led(D16);

    while (true)
    {
        /* Spin for ever */
        k_sleep(K_MSEC(1000));
    }
}

int my_nus_main()
{
    int err;

    k_sem_give(&sem_reading);

    bt_conn_cb_register(&connection_callbacks);

    err = bt_enable(NULL);
    if (err)
    {
        error();
    }

    LOG_INF("Bluetooth initialized");

    k_sem_give(&ble_init_ok);

    if (IS_ENABLED(CONFIG_SETTINGS))
    {
        settings_load();
    }
    err = bt_nus_init(&nus_cb);
    if (err)
    {
        LOG_ERR("Failed to initialize UART service (err: %d)", err);
        return -1;
    }

    err = bt_le_adv_start(BT_LE_ADV_CONN, ad, ARRAY_SIZE(ad), sd, ARRAY_SIZE(sd));
    if (err)
    {
        LOG_ERR("Advertising failed to start (err %d)", err);
        return -1;
    }

    return 0;
}

void writeToBufAsHex(const char *buf, const size_t len, char *t)
{
    for (size_t j = 0; j < len; j++)
    {
        t[5 * j + 0] = '0';
        t[5 * j + 1] = 'x';

        int t0 = buf[j];
        int t1 = t0 / 16;
        int t2 = t0 % 16;

        if (t1 > 9)
        {
            t[5 * j + 2] = (char)(0x41 + t1 - 10);
        }
        else
        {
            t[5 * j + 2] = (char)(0x30 + t1);
        }
        if (t2 > 9)
        {
            t[5 * j + 3] = (char)(0x41 + t2 - 10);
        }
        else
        {
            t[5 * j + 3] = (char)(0x30 + t2);
        }
        t[5 * j + 4] = ' ';
    }
}

void encodeIntegerIntoChar(const uint32_t value, char *buf, const size_t max_len, size_t *len)
{
    if (max_len < 4)
        return;
    buf[0] = 0x000000ff & value << 0;
    buf[1] = 0x0000ff00 & value << 8;
    buf[2] = 0x00ff0000 & value << 16;
    buf[3] = 0xff000000 & value << 24;
    *len = 4;
    return;
}
void _encodeIntegerIntoCharUNSAFE(uint32_t value, uint8_t *buf)
{

    value = 0x54455354;
    buf[0] = (uint8_t)(0x000000ff & value << 0);
    buf[1] = (uint8_t)(0x0000ff00 & value << 8);
    buf[2] = (uint8_t)(0x00ff0000 & value << 16);
    buf[3] = (uint8_t)(0xff000000 & value << 24);
}

#define READING_MAX_SIZE 5
static struct reading
{
    fb_motor_angle_t motor_angles;
    fb_motor_speed_t motor_speeds;
    int v_cap;
} readings[READING_MAX_SIZE];
static size_t reading_pos = 0;
static size_t readings_filled = 0;

// comma seperated
static fb_motor_angle_t motor_angles;
static fb_motor_speed_t motor_speeds;

// blocking write
static inline void writeToCycReadingsBuf(struct reading r)
{
    k_sem_take(&sem_reading, K_FOREVER);
    readings[reading_pos] = r; // passed by value or reference! (if ref => floating pointer)
    reading_pos = (reading_pos + 1) % READING_MAX_SIZE;
    if (readings_filled < READING_MAX_SIZE)
        readings_filled++;
    k_sem_give(&sem_reading);
}

// does not purge, just resets the pointers
static inline void resetReadingsBuf()
{
    reading_pos = 0;
    readings_filled = 0;
}

void sensor_read_thread(void)
{
    for (;;)
    {
        fb_get_motor_angle(&motor_angles);
        fb_get_motor_speed(&motor_speeds);
        int vcap = fb_v_measure();

        struct reading r = {
            .motor_angles = {
                .back_left = motor_angles.back_left,
                .back_right = motor_angles.back_right,
                .front_left = motor_angles.front_left,
                .front_right = motor_angles.front_right},
            .motor_speeds = {
                .back_left = motor_speeds.back_left,
                .back_right = motor_speeds.back_right,
                .front_left = motor_speeds.front_left,
                .front_right = motor_speeds.front_right,
            },
            .v_cap = vcap};

        writeToCycReadingsBuf(r);
        k_sleep(K_MSEC(200));
    }
}
K_THREAD_DEFINE(sensor_read_thread_id, STACKSIZE, sensor_read_thread, NULL, NULL, NULL, PRIORITY, 0, 0);

enum readingType_t
{
    AFL,
    AFR,
    ABL,
    ABR,
    DFL,
    DFR,
    DBL,
    DBR,
    VCA,
};

const enum readingType_t toTransmit[] = {
    VCA,
    DFL,
    DFR,
    DBL,
    DBR,
};

/*
    motor_angles.front_left, //Z
    motor_angles.front_right, //Y
    motor_angles.back_left, //X
    motor_angles.back_right); //W
    motor_speeds.front_left, //V
    motor_speeds.front_right, //U
    motor_speeds.back_left, //T
    motor_speeds.back_right); //S
    fb_v_measure_select(V_CAP); //R
    '_' if unknown
*/
char convertReadingTypeToChar(const enum readingType_t t)
{
    switch (t)
    {
    case AFL:
        return 'Z';
    case AFR:
        return 'Y';
    case ABL:
        return 'X';
    case ABR:
        return 'W';
    case DFL:
        return 'V';
    case DFR:
        return 'U';
    case DBL:
        return 'T';
    case DBR:
        return 'S';
    case VCA:
        return 'R';
    default:
        return '_';
    }
}
int readVal(const enum readingType_t t, const struct reading *r)
{
    switch (t)
    {
    case AFL:
        return r->motor_angles.front_left;
    case AFR:
        return r->motor_angles.front_right;
    case ABL:
        return r->motor_angles.back_left;
    case ABR:
        return r->motor_angles.back_right;
    case DFL:
        return r->motor_speeds.front_left;
    case DFR:
        return r->motor_speeds.front_right;
    case DBL:
        return r->motor_speeds.back_left;
    case DBR:
        return r->motor_speeds.back_right;
    case VCA:
        return r->v_cap;
    default:
        return 0;
    }
}

/**
 * @brief Serialize the average reading of the last 5
 *
 * @param dest
 * @param t
 * @param r
 * @return int
 */
int serialize_reading(uint8_t *dest, const enum readingType_t t, const struct reading *r)
{
    size_t pos = 0; // position in the buffer

    size_t p_s = 0; // read from here
    size_t p_e = 0; // till here (exclusiding the element @p_e)
    if (readings_filled == READING_MAX_SIZE)
    {
        // run from p -> p+f under mod READING_MAX_SIZE
        p_s = reading_pos;
        p_e = reading_pos + readings_filled;
    }
    else if (readings_filled > READING_MAX_SIZE)
    {
        // something went wrong, read from 0 -> READING_MAX_SIZE - 1
        p_s = 0;
        p_e = READING_MAX_SIZE;
    }
    else
    {
        // run from 0 -> f (=p-1) under mod READING_MAX_SIZE, here the mod can be dropped since f < READING_MAX_SIZE (see if statement)
        p_s = 0;
        p_e = readings_filled;
    }

    // *(uint16_t*)&(dest[pos]) = 0x4100;
    // return 2;

    int total_value = 0;

    for (size_t i = p_s; i < p_e; i++)
    {
        // read sensor values as an absolute value
        int val = readVal(t, &(r[i % READING_MAX_SIZE]));
        if (val < 0)
            val *= -1;
        total_value += val;
    }

    if (p_e - p_s == 0)
        *(uint16_t *)&(dest[pos]) = 0x0000;
    else
        *(uint16_t *)&(dest[pos]) = (uint16_t)(total_value / (p_e - p_s));
    pos += sizeof(uint16_t);
    return pos;
}

/**
 * @brief
 *
 * @param dest
 * @return int the nubmer of characters written
 */
int serialize_readings_buf(uint8_t *dest)
{
    size_t pos = 0;
    dest[pos++] = '1';
    dest[pos++] = '3';
    k_sem_take(&sem_reading, K_FOREVER);
    for (size_t i = 0; i < sizeof(toTransmit) / sizeof(enum readingType_t); i++)
    {
        pos += serialize_reading(&dest[pos], toTransmit[i], readings);
        if (i < sizeof(toTransmit) / sizeof(enum readingType_t) - 1)
            dest[pos++] = ',';
    }
    k_sem_give(&sem_reading);

    return pos;
}

uint8_t bt_tx_buffer[40] = {0};
void ble_write_thread(void)
{
    for (;;)
    {
        int pos = serialize_readings_buf(bt_tx_buffer);

        k_sem_take(&ble_init_ok, K_FOREVER);
        /* Send data over Bluetooth LE to remote device(s) */
        if (bt_nus_send(NULL, bt_tx_buffer, pos))
        {
            LOG_WRN("Failed to send data over BLE connection");
        }
        k_sem_give(&ble_init_ok);
        // shred old message. (not per se required)
        memset(bt_tx_buffer, 0, pos);
        k_sleep(K_MSEC(1000));
    }
}
/* Create a dedicated thread for sending the data over Bluetooth LE. */
K_THREAD_DEFINE(ble_write_thread_id, STACKSIZE, ble_write_thread, NULL, NULL, NULL, PRIORITY, 0, 0);

#define CMD_RUN_DELAY K_MSEC(500)
void processCommand(const char *cmd, const size_t len)
{
    if (len != 5)
        return;
    char *prependedCmd = "13<";
    if (memcmp(cmd, prependedCmd, 3) != 0)
        return;
    if (cmd[len - 1] != '>')
        return; // mallformed commands

    switch (cmd[len - 2])
    {
    case 'F':
        fb_straight_forw();
        break;
    case 'B':
        fb_straight_back();
        break;
    case 'L':
        fb_side_left();
        break;
    case 'R':
        fb_side_right();
        break;
    case '1':
        fb_side_d45();
        break;
    case '2':
        fb_side_d135();
        break;
    case '3':
        fb_side_d225();
        break;
    case '4':
        fb_side_d315();
        break;
    case 'C':
        fb_rotate_cw();
        break;
    case 'D':
        fb_rotate_ccw();
        break;

    default:
        break;
    }

    /*
    F = forward
    B = back
    R = right
    L = left
    1 = 45
    2 = 135
    3 = 225
    4 = 315
    C = clock
    D = counter clock
    */
}

void read_thread(void)
{
    for (int i = 0;; i++)
    {
        /* Wait indefinitely for data from the UART peripheral */
        struct packet_data_t *buf = k_fifo_get(&fifo_rx_data, K_FOREVER);

        if (buf->len == 4 && buf->data[buf->len - 1] == '\000')
            processCommand(buf->data, 3);
        else
            processCommand(buf->data, buf->len);
        k_free(buf);
        k_sleep(CMD_RUN_DELAY);
        fb_stop();
    }
}
/* Create a dedicated thread for sending the data over Bluetooth LE. */
K_THREAD_DEFINE(ble_read_thread_id, STACKSIZE, read_thread, NULL, NULL, NULL, PRIORITY, 0, 0);
```

## src/my_nus_stuff.h
```c
#ifndef MY_NUS_STUFF_H
#define MY_NUS_STUFF_H

#include <zephyr/kernel.h>

#define STACKSIZE CONFIG_BT_NUS_THREAD_STACK_SIZE
#define PRIORITY 7

#define PASSKEY 99

static K_FIFO_DEFINE(fifo_tx_data);
static K_FIFO_DEFINE(fifo_rx_data);
static K_SEM_DEFINE(ble_init_ok, 0, 1);

/* STEP 6.2 - Declare the struct of the data item of the FIFOs */
struct packet_data_t
{
    void *fifo_reserved;
    uint8_t data[CONFIG_BT_NUS_UART_BUFFER_SIZE];
    uint16_t len;
};

int my_nus_main();

#endif // MY_NUS_STUFF_H
```

## src/uart_async_adapter.c
```c
/*
 * Copyright (c) 2021 Nordic Semiconductor ASA
 *
 * SPDX-License-Identifier: LicenseRef-Nordic-5-Clause
 */

/** @file
 *  @brief UART asynchronous API adapter implementation
 */
#include "uart_async_adapter.h"
#include <zephyr/drivers/uart.h>
#include <zephyr/sys/__assert.h>

#include <zephyr/logging/log.h>
LOG_MODULE_REGISTER(uart_async_adapter);

#if !IS_ENABLED(CONFIG_UART_ASYNC_API)
#error "This adapter requires UART ASYNC API to be enabled"
#endif

#if !IS_ENABLED(CONFIG_UART_INTERRUPT_DRIVEN)
#error "The adapter requires UART INTERRUPT API to be enabled"
#endif

/**
 * @brief Access the data inside device
 *
 * This function gets the pointer to the user data inside device
 *
 * @param dev Device to get adapter data
 * @return Pointer to device data
 */
static struct uart_async_adapter_data *access_dev_data(const struct device *dev)
{
	__ASSERT_NO_MSG(dev);
	__ASSERT_NO_MSG(dev->data);
	return (struct uart_async_adapter_data *)(dev->data);
}

/**
 * @brief Call the sync callback function
 *
 * @param dev UART device structure.
 * @param evt Pointer to uart_event structure.
 */
static void user_callback(const struct device *dev, struct uart_event *evt)
{
	struct uart_async_adapter_data *data = access_dev_data(dev);

	if (data->user_callback) {
		data->user_callback(dev, evt, data->user_data);
	}
}

static int callback_set(const struct device *dev, uart_callback_t callback, void *user_data)
{
	struct uart_async_adapter_data *data = access_dev_data(dev);

	data->user_callback = callback;
	data->user_data = user_data;

	return 0;
}

static inline void notify_rx_buffer(const struct device *dev)
{
	struct uart_event event = { UART_RX_RDY };
	struct uart_async_adapter_data *data = access_dev_data(dev);
	bool notify = false;

	k_spinlock_key_t key = k_spin_lock(&(data->lock));

	if (data->rx.buf) {
		__ASSERT_NO_MSG(data->rx.curr_buf >= data->rx.buf);
		__ASSERT_NO_MSG(data->rx.curr_buf >= data->rx.last_notify_buf);
		if (data->rx.curr_buf > data->rx.last_notify_buf) {
			event.data.rx.buf = data->rx.buf;
			event.data.rx.len = data->rx.curr_buf - data->rx.last_notify_buf;
			event.data.rx.offset = data->rx.last_notify_buf - data->rx.buf;
			data->rx.last_notify_buf = data->rx.curr_buf;
			notify = true;
		}
	}

	k_spin_unlock(&(data->lock), key);

	if (notify) {
		LOG_DBG("Notification: UART_RX_RDY (0x%x + %d, size: %d)",
			(unsigned int)event.data.rx.buf, event.data.rx.offset, event.data.rx.len);
		user_callback(dev, &event);
	}
}

static inline void notify_rx_buffer_release(const struct device *dev, uint8_t *buf)
{
	struct uart_event event = { .type = UART_RX_BUF_RELEASED, .data.rx_buf.buf = buf };
	LOG_DBG("Notification: UART_RX_BUF_RELEASED");
	user_callback(dev, &event);
}

static inline void notify_rx_buffer_req(const struct device *dev)
{
	struct uart_event event = {
		.type = UART_RX_BUF_REQUEST,
	};
	LOG_DBG("Notification: UART_RX_BUF_REQUEST");
	user_callback(dev, &event);
}

static inline void switch_rx_buffer(const struct device *dev, bool request_new)
{
	struct uart_async_adapter_data *data = access_dev_data(dev);
	uint8_t *old_buf;

	k_spinlock_key_t key = k_spin_lock(&(data->lock));

	old_buf = data->rx.buf;
	data->rx.buf = data->rx.next_buf;
	data->rx.curr_buf = data->rx.next_buf;
	data->rx.last_notify_buf = data->rx.next_buf;
	data->rx.size_left = data->rx.next_buf_len;
	data->rx.next_buf = NULL;
	data->rx.next_buf_len = 0;

	k_spin_unlock(&(data->lock), key);

	if (old_buf) {
		notify_rx_buffer_release(dev, old_buf);
	}
	if (request_new) {
		notify_rx_buffer_req(dev);
	}
}

static int tx(const struct device *dev, const uint8_t *buf, size_t len, int32_t timeout)
{
	int ret = 0;
	struct uart_async_adapter_data *data = access_dev_data(dev);
	bool tx_send = false;

	LOG_DBG("%s(%s, 0x%x, %u, %d)", __func__, dev->name, (unsigned int)buf, len, timeout);

	k_spinlock_key_t key = k_spin_lock(&(data->lock));

	if (!len) {
		LOG_DBG("%s: no data", __func__);
	} else if (data->tx.buf) {
		ret = -EBUSY;
		LOG_DBG("%s: busy", __func__);
	} else {
		data->tx.buf = buf;
		data->tx.curr_buf = buf;
		data->tx.size_left = len;
		data->tx.enabled = true;
		tx_send = true;
		LOG_DBG("%s: sending", __func__);
	}

	k_spin_unlock(&(data->lock), key);

	if (tx_send) {
		uart_irq_tx_enable(data->target);
	}
	if (tx_send && timeout != SYS_FOREVER_MS) {
		k_timer_start(&data->tx.timeout_timer, SYS_TIMEOUT_MS(timeout), K_NO_WAIT);
	}
	return ret;
}

static int tx_abort(const struct device *dev)
{
	int ret = 0;
	struct uart_event event = { UART_TX_ABORTED };
	struct uart_async_adapter_data *data = access_dev_data(dev);

	data->tx.enabled = false;
	k_timer_stop(&data->tx.timeout_timer);
	uart_irq_tx_disable(data->target);

	k_spinlock_key_t key = k_spin_lock(&(data->lock));

	if (data->tx.buf == NULL) {
		ret = -EFAULT;
	} else {
		/* Set the event data */
		event.data.tx.buf = data->tx.buf;
		event.data.tx.len = data->tx.curr_buf - data->tx.buf;
		/* Clear any pending tx */
		data->tx.buf = NULL;
		data->tx.curr_buf = NULL;
		data->tx.size_left = 0;
	}

	k_spin_unlock(&(data->lock), key);

	if (!ret) {
		user_callback(dev, &event);
	}
	return ret;
}

static int rx_enable(const struct device *dev, uint8_t *buf, size_t len, int32_t timeout)
{
	int ret = 0;
	struct uart_async_adapter_data *data = access_dev_data(dev);

	k_spinlock_key_t key = k_spin_lock(&(data->lock));

	if (data->rx.next_buf || data->rx.buf) {
		ret = -EBUSY;
	}
	data->rx.buf = NULL;
	data->rx.curr_buf = NULL;
	data->rx.size_left = 0;
	data->rx.next_buf = buf;
	data->rx.next_buf_len = len;
	data->rx.timeout = timeout;
	data->rx.enabled = true;

	k_spin_unlock(&(data->lock), key);

	uart_irq_rx_enable(data->target);
	uart_irq_err_enable(data->target);
	return ret;
}

static int rx_buf_rsp(const struct device *dev, uint8_t *buf, size_t len)
{
	int ret = 0;
	struct uart_async_adapter_data *data = access_dev_data(dev);

	k_spinlock_key_t key = k_spin_lock(&(data->lock));

	if (data->rx.next_buf) {
		ret = -EBUSY;
	} else {
		__ASSERT_NO_MSG(!data->rx.next_buf_len);
		data->rx.next_buf = buf;
		data->rx.next_buf_len = len;
	}

	k_spin_unlock(&(data->lock), key);

	return ret;
}

static int rx_disable(const struct device *dev)
{
	int ret = 0;
	struct uart_async_adapter_data *data = access_dev_data(dev);
	struct uart_event event_disabled = { UART_RX_DISABLED };

	data->rx.enabled = false;
	uart_irq_rx_disable(data->target);
	uart_irq_err_disable(data->target);
	while (data->rx.buf) {
		switch_rx_buffer(dev, false);
	}

	user_callback(dev, &event_disabled);

	return ret;
}

/* Basic interface */

static int poll_in(const struct device *dev, unsigned char *p_char)
{
	__ASSERT_NO_MSG(dev);

	const struct uart_async_adapter_data *data = dev->data;

	__ASSERT_NO_MSG(data);
	__ASSERT_NO_MSG(data->target);

	return uart_poll_in(data->target, p_char);
}

static void poll_out(const struct device *dev, unsigned char out_char)
{
	__ASSERT_NO_MSG(dev);

	const struct uart_async_adapter_data *data = dev->data;

	__ASSERT_NO_MSG(data);
	__ASSERT_NO_MSG(data->target);

	uart_poll_out(data->target, out_char);
}

static int err_check(const struct device *dev)
{
	__ASSERT_NO_MSG(dev);

	const struct uart_async_adapter_data *data = dev->data;

	__ASSERT_NO_MSG(data);
	__ASSERT_NO_MSG(data->target);

	return uart_err_check(data->target);
}

static int configure(const struct device *dev, const struct uart_config *cfg)
{
	__ASSERT_NO_MSG(dev);

	const struct uart_async_adapter_data *data = dev->data;

	__ASSERT_NO_MSG(data);
	__ASSERT_NO_MSG(data->target);

	return uart_configure(data->target, cfg);
}

static int config_get(const struct device *dev, struct uart_config *cfg)
{
	__ASSERT_NO_MSG(dev);

	const struct uart_async_adapter_data *data = dev->data;

	__ASSERT_NO_MSG(data);
	__ASSERT_NO_MSG(data->target);

	return uart_config_get(data->target, cfg);
}

#ifdef CONFIG_UART_LINE_CTRL

static int line_ctrl_set(const struct device *dev, uint32_t ctrl, uint32_t val)
{
	__ASSERT_NO_MSG(dev);

	const struct uart_async_adapter_data *data = dev->data;

	__ASSERT_NO_MSG(data);
	__ASSERT_NO_MSG(data->target);

	return uart_line_ctrl_set(data->target, ctrl, val);
}

static int line_ctrl_get(const struct device *dev, uint32_t ctrl, uint32_t *val)
{
	__ASSERT_NO_MSG(dev);

	const struct uart_async_adapter_data *data = dev->data;

	__ASSERT_NO_MSG(data);
	__ASSERT_NO_MSG(data->target);

	return uart_line_ctrl_get(data->target, ctrl, val);
}

#endif /* CONFIG_UART_LINE_CTRL */

#ifdef CONFIG_UART_DRV_CMD

static int drv_cmd(const struct device *dev, uint32_t cmd, uint32_t p)
{
	__ASSERT_NO_MSG(dev);

	const struct uart_async_adapter_data *data = dev->data;

	__ASSERT_NO_MSG(data);
	__ASSERT_NO_MSG(data->target);

	return uart_drv_cmd(data->target, cmd, p);
}

#endif /* CONFIG_UART_DRV_CMD */

static inline void on_tx_ready(const struct device *dev, struct uart_async_adapter_data *data)
{
	k_spinlock_key_t key = k_spin_lock(&(data->lock));

	LOG_DBG("%s: Enter(%s) (left: %u)", __func__, dev->name, data->tx.size_left);
	if (data->tx.size_left) {
		__ASSERT_NO_MSG(data->tx.curr_buf);
		int ret;

		ret = uart_fifo_fill(data->target, data->tx.curr_buf, data->tx.size_left);
		LOG_DBG("Pushed %d characters", ret);
		if (ret <= 0) {
			LOG_ERR("Unexpected fifo fill err: %d", ret);
		} else {
			data->tx.curr_buf += ret;
			data->tx.size_left -= ret;
		}
	}

	k_spin_unlock(&(data->lock), key);

	LOG_DBG("%s: Exit", __func__);
}

static inline void on_tx_complete(const struct device *dev, struct uart_async_adapter_data *data)
{
	LOG_DBG("%s: Enter(%s)", __func__, dev->name);
	if (!data->tx.size_left) {
		struct uart_event event = { UART_TX_DONE };

		data->tx.enabled = false;
		uart_irq_tx_disable(data->target);

		k_spinlock_key_t key = k_spin_lock(&(data->lock));

		if (data->tx.buf) {
			__ASSERT_NO_MSG(data->tx.curr_buf);
			__ASSERT_NO_MSG(data->tx.curr_buf >= data->tx.buf);
			/* Transfer really finished */
			event.data.tx.buf = data->tx.buf;
			event.data.tx.len = data->tx.curr_buf - data->tx.buf;
			/* Clear any pending tx */
			data->tx.buf = NULL;
			data->tx.curr_buf = NULL;
			data->tx.size_left = 0;
		}

		k_spin_unlock(&(data->lock), key);

		if (event.data.tx.buf) {
			LOG_DBG("Notification: UART_TX_DONE (0x%x, size: %d)",
				(unsigned int)event.data.tx.buf, event.data.tx.len);
			user_callback(dev, &event);
		} else {
			LOG_ERR("TX buffer NULL on tx complete");
		}
	}
	LOG_DBG("%s: Exit", __func__);
}

static inline void on_rx_ready(const struct device *dev, struct uart_async_adapter_data *data)
{
	int ret;
	bool notify_now = false;

	LOG_DBG("%s: Enter (%s)", __func__, dev->name);
	if (data->rx.timeout != SYS_FOREVER_MS) {
		k_timer_start(&data->rx.timeout_timer, SYS_TIMEOUT_MS(data->rx.timeout), K_NO_WAIT);
	}
	do {
		k_spinlock_key_t key = k_spin_lock(&(data->lock));

		if (!data->rx.size_left) {
			notify_now = false;

			k_spin_unlock(&(data->lock), key);

			notify_rx_buffer(dev);
			switch_rx_buffer(dev, true);

			key = k_spin_lock(&(data->lock));
		}
		if (!data->rx.size_left) {
			/* Data received without buffer - dropping */
			uint8_t dummy;
			size_t cnt = 0;

			do {
				ret = uart_fifo_read(data->target, &dummy, 1);
				if (ret < 0) {
					LOG_ERR("Unexpected error on FIFO dropping: %d", ret);
					ret = 0;
				}
				cnt += ret;
			} while (ret);
			LOG_ERR("Data received without buffer prepared, dropped %d bytes", cnt);
		} else {
			ret = uart_fifo_read(data->target, data->rx.curr_buf, data->rx.size_left);
			LOG_DBG("Received %d characters", ret);
			if (ret < 0) {
				LOG_ERR("Unexpected error on FIFO read: %d", ret);
				ret = 0;
			}
			__ASSERT_NO_MSG(data->rx.size_left >= ret);
			data->rx.curr_buf += ret;
			data->rx.size_left -= ret;
			if (data->rx.timeout == 0) {
				notify_now = true;
			}
		}

		k_spin_unlock(&(data->lock), key);

	} while (ret);
	if (notify_now) {
		notify_rx_buffer(dev);
	}
	LOG_DBG("%s: Exit", __func__);
}

static inline void on_error(const struct device *dev, struct uart_async_adapter_data *data,
			    int rx_err)
{
	struct uart_event event = { .type = UART_RX_STOPPED, .data.rx_stop.reason = rx_err };

	LOG_DBG("%s: Enter(%s)", __func__, dev->name);
	rx_disable(data->target);
	user_callback(dev, &event);
	LOG_DBG("%s: Exit", __func__);
}

static void uart_irq_handler(const struct device *target_dev, void *context)
{
	const struct device *dev = context;
	struct uart_async_adapter_data *data = access_dev_data(dev);

	__ASSERT(target_dev == data->target,
		 "IRQ handler called with a context that seems uninitialized.");
	LOG_DBG("irq_handler: Enter");
	if (uart_irq_update(target_dev) && uart_irq_is_pending(target_dev)) {
		if (data->tx.enabled && uart_irq_tx_ready(target_dev)) {
			on_tx_ready(dev, data);
		}
		if (data->tx.enabled && uart_irq_tx_complete(target_dev)) {
			on_tx_complete(dev, data);
		}
		if (data->rx.enabled && uart_irq_rx_ready(target_dev)) {
			on_rx_ready(dev, data);
		}

		/* Check errors only after all the data is received from the device */
		int rx_err = uart_err_check(target_dev);

		if (rx_err < 0) {
			rx_err = 0;
		}
		if (data->rx.enabled && rx_err) {
			on_error(dev, data, rx_err);
		}
	}
	LOG_DBG("irq_handler: Exit");
}

const struct uart_driver_api uart_async_adapter_driver_api = {
	/* Async interface */
	.callback_set = callback_set,
	.tx = tx,
	.tx_abort = tx_abort,
	.rx_enable = rx_enable,
	.rx_buf_rsp = rx_buf_rsp,
	.rx_disable = rx_disable,

	/* Basic functions */
	.poll_in = poll_in,
	.poll_out = poll_out,
	.err_check = err_check,
	.configure = configure,
	.config_get = config_get,

#ifdef CONFIG_UART_LINE_CTRL
	.line_ctrl_set = line_ctrl_set,
	.line_ctrl_get = line_ctrl_get
#endif

#ifdef CONFIG_UART_DRV_CMD
				 .drv_cmd = drv_cmd
#endif
};

static void tx_timeout(struct k_timer *timer)
{
	const struct device *dev = k_timer_user_data_get(timer);

	(void)tx_abort(dev);
}

static void rx_timeout(struct k_timer *timer)
{
	const struct device *dev = k_timer_user_data_get(timer);

	notify_rx_buffer(dev);
}

void uart_async_adapter_init(const struct device *dev, const struct device *target)
{
	__ASSERT_NO_MSG(dev);
	__ASSERT_NO_MSG(dev->api);
	__ASSERT(dev->api == &uart_async_adapter_driver_api,
		 "This is not uart_async_adapter device");

	struct uart_async_adapter_data *data = access_dev_data(dev);

	data->target = target;
	uart_irq_callback_user_data_set(data->target, uart_irq_handler, (void *)dev);

	k_timer_init(&data->tx.timeout_timer, tx_timeout, NULL);
	k_timer_user_data_set(&data->tx.timeout_timer, (void *)dev);
	k_timer_init(&data->rx.timeout_timer, rx_timeout, NULL);
	k_timer_user_data_set(&data->rx.timeout_timer, (void *)dev);

	dev->state->initialized = true;
}
```
